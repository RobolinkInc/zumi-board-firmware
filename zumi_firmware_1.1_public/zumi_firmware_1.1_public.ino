/*
  Copyright (c) 2019 Robolink, Inc

  Permission is hereby granted, free of charge, to any person obtaining a copy
  of this software and associated documentation files (the "Software"), to deal
  in the Software without restriction, including without limitation the rights
  to use, copy, modify, merge, publish, distribute, sublicense, and/or sell
  copies of the Software, and to permit persons to whom the Software is
  furnished to do so, subject to the following conditions:

  The above copyright notice and this permission notice shall be included in all
  copies or substantial portions of the Software.

  THE SOFTWARE IS PROVIDED "AS IS", WITHOUT WARRANTY OF ANY KIND, EXPRESS OR
  IMPLIED, INCLUDING BUT NOT LIMITED TO THE WARRANTIES OF MERCHANTABILITY,
  FITNESS FOR A PARTICULAR PURPOSE AND NONINFRINGEMENT. IN NO EVENT SHALL THE
  AUTHORS OR COPYRIGHT HOLDERS BE LIABLE FOR ANY CLAIM, DAMAGES OR OTHER
  LIABILITY, WHETHER IN AN ACTION OF CONTRACT, TORT OR OTHERWISE, ARISING FROM,
  OUT OF OR IN CONNECTION WITH THE SOFTWARE OR THE USE OR OTHER DEALINGS IN THE
  SOFTWARE.

  This code is for the Zumi board
  https://www.robolink.com/zumi/

  If you have any questions please check out our forum
  http://robolink.com:4567/category/14/zumi
*/
#define VERSION_NUMBER 1.10
#define DEBUG false //if you enable this, I2C messages may drop

#include <Wire.h>

//These libraries can be installed
//using the library manager
#include <Adafruit_SSD1306.h>
#include <Adafruit_GFX.h>

#define SLAVE_ADDRESS 0x04

#define ARD_PI_PIN 2

#define IR_EMIT_PIN 3 
#define IR_REMREC_PIN 4 //not used in Zumi firmware

#define MOTOR_LEFT_A 5
#define MOTOR_LEFT_B 6
#define MOTOR_RIGHT_A 10
#define MOTOR_RIGHT_B 9

#define BACK_LEFT_LED  7
#define BACK_RIGHT_LED  8
#define FRONT_RIGHT_LED 11
#define FRONT_LEFT_LED 12
#define Z_LED 13

#define BUZZER_PIN 14

#define MUX_S0 15
#define MUX_S1 16
#define MUX_S2 17
#define MUX_OUTPUT 21

#define BATT_LVL_PIN 20

//Each battery will reach different max voltages For example: 4.14, 4.19.
#define USB_VOLTAGE_DETECTED 1.7
#define MIN_BATTERY_VOLTAGE 3.45
#define MAX_BATTERY_VOLTAGE 4.14

#define RIGHT_FRONT_IR  1
#define LEFT_FRONT_IR   6

#define RIGHT_BOTTOM_IR 2
#define LEFT_BOTTOM_IR  4

#define RIGHT_REAR_IR   3
#define LEFT_REAR_IR    5

#define USB_POWER_DETECTED 1    // only usb power "charging" (voltage < USB_VOLTAGE_DETECTED)
#define LOW_BATTERY_DETECTED 2  // low batt mode (USB_VOLTAGE_DETECTED < voltage < MIN_BATTERY_VOLTAGE ) 
#define GOOD_BATTERY_DETECTED 3 // battery detected and in working condition (voltage > MIN_BATTERY_VOLTAGE)

// stringification for Arduino IDE version
// for displaying the version of Arduino over Serial
#define xstr(s) str(s)
#define str(s) #s

//setup for OLED
#define RESET_PIN -1 //null parameter
#define SCREEN_WIDTH 128
#define SCREEN_HEIGHT 64

// Initialize a display
Adafruit_SSD1306 display(SCREEN_WIDTH, SCREEN_HEIGHT, &Wire, RESET_PIN);

// Initialize an array to contain the data that is sent to the Pi on request
byte outputArray[10];
//[0-5] ir Sensor reading,
//[6] battery level 
//[7] 5v rail level
//[8] zumi board fimrware version
//[9] user can put whatever they want

// Variables to handle LED states
byte LEDbyte = 0;
bool LEDtoggle = 0; //to handle the on/off toggling of the LED's

// Variables to handle notes
int noteType = -1;
int noteDuration;

// Variables to handle battery voltage
double batteryVoltage = 0.0;
long vccMilliVolts = 0;

byte bootupCounter = 0; //keeps track of counter that disables charge only mode
byte wakingUpProgress = 0;
bool arduinoI2CMaster = true;
bool chargeOnlyMode = false;
bool PiBooted = false;
bool displayWarning = false;

bool disable_sound = false;
bool disable_led_byte = false;
bool IREmitOn = true;
bool disable_IRreadings = false;

// Image data for Zumi's opened eyes
static const unsigned char PROGMEM cant_wake_up[] =
{
  B00000000, B00000000, B00000000, B00000000, B00000000, B00000000, B00000000, B00000000, B00000000, B00000000, B00000000, B00000000, B00000000, B00000000, B00000000, B00000000,
  B00000000, B00000000, B00000000, B00000000, B00000000, B00000000, B00000000, B00000000, B00000000, B00000000, B00000000, B00000000, B00000000, B00000000, B00000000, B00000000,
  B00000000, B00000000, B00000000, B00000000, B00000000, B00000000, B00000000, B00000000, B00000000, B00000000, B00000000, B00000000, B00000000, B00000000, B00000000, B00000000,
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  B00000000, B00000000, B00000000, B00000000, B00000000, B00000000, B00000000, B00000000, B00000000, B00000000, B00000000, B00000000, B00000000, B00000000, B00000000, B00000000,

};


// Image data for Zumi's closed eyes
static const unsigned char PROGMEM zumi_woke_ing_up[] =
{
  B00000000, B00000000, B00000000, B00000000, B00000000, B00000000, B00000000, B00000000, B00000000, B00000000, B00000000, B00000000, B00000000, B00000000, B00000000, B00000000,
  B00000000, B00000000, B00000000, B00000000, B00000000, B00000000, B00000000, B00000000, B00000000, B00000000, B00000000, B00000000, B00000000, B00000000, B00000000, B00000000,
  B00000000, B00000000, B00000000, B00000000, B00000000, B00000000, B00000000, B00000000, B00000000, B00000000, B00000000, B00000000, B00000000, B00000000, B00000000, B00000000,
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  B00000000, B00000000, B00000000, B00000000, B00000000, B00000000, B00000000, B00000000, B00000000, B00000000, B00000000, B00000000, B00000000, B00000000, B00000000, B00000000,
};

// Image data for Zumi's closed eyes
static const unsigned char PROGMEM emptyBattery[] =
{
  B00000000, B00000000, B00000000, B00000000, B00000000, B00000000, B00000000, B00000000, B00000000, B00000000, B00000000, B00000000, B00000000, B00000000, B00000000, B00000000,
  B00000000, B00000000, B00000000, B00000000, B00000000, B00000000, B00000000, B00000000, B00000000, B00000000, B00000000, B00000000, B00000000, B00000000, B00000000, B00000000,
  B00000000, B00000000, B00000000, B00000000, B00000000, B00000000, B00000000, B00000000, B00000000, B00000000, B00000000, B00000000, B00000000, B00000000, B00000000, B00000000,
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  B00000000, B00000000, B00000000, B00000000, B00000000, B00000000, B00000000, B00000000, B00000000, B00000000, B00000000, B00000000, B00000000, B00000000, B00000000, B00000000
};


// Image data for Zumi's closed eyes
static const unsigned char PROGMEM zumi_charging_fullsize[] =
{
  B00000000, B00000000, B00000000, B00000000, B00000000, B00000000, B00000000, B00000000, B00000000, B00000000, B00000000, B00000000, B00000000, B00000000, B00000000, B00000000,
  B00000000, B00000000, B00000000, B00000000, B00000000, B00000000, B00000000, B00000000, B00000000, B00000000, B00000000, B00000000, B00000000, B00000000, B00000000, B00000000,
  B00000000, B00000000, B00000000, B00000000, B00000000, B00000000, B00000000, B00000000, B00000000, B00000000, B00000000, B00000000, B00000000, B00000000, B00000000, B00000000,
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  B00000000, B00000000, B00000000, B00000000, B00000000, B00000000, B00000000, B00000000, B00000000, B00000000, B00000000, B00000000, B00000000, B00000000, B00000000, B00000000
};

// Image data for Zumi's closed eyes
static const unsigned char PROGMEM zumi_logo_fullsize[] =
{
  B00000000, B00000000, B00000000, B00000000, B00000000, B00000000, B00000000, B00000000, B00000000, B00000000, B00000000, B00000000, B00000000, B00000000, B00000000, B00000000,
  B00000000, B00000000, B00000000, B00000000, B00000000, B00000000, B00000000, B00000000, B00000000, B00000000, B00000000, B00000000, B00000000, B00000000, B00000000, B00000000,
  B00000000, B00000000, B00000000, B00000000, B00000000, B00000000, B00000000, B00000000, B00000000, B00000000, B00000000, B00000000, B00000000, B00000000, B00000000, B00000000,
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  B00000000, B00000000, B00000000, B00000000, B00000000, B00000000, B00000000, B00000000, B00000000, B00000000, B00000000, B00000000, B00000000, B00000000, B00000000, B00000000
};



void setup() {

  // Motor controller setup
  pinMode(MOTOR_LEFT_A, OUTPUT);
  pinMode(MOTOR_LEFT_B, OUTPUT);
  pinMode(MOTOR_RIGHT_A, OUTPUT);
  pinMode(MOTOR_RIGHT_B, OUTPUT);

  // Stop motors
  digitalWrite(MOTOR_LEFT_A, LOW);
  digitalWrite(MOTOR_LEFT_B, LOW);
  digitalWrite(MOTOR_RIGHT_A, LOW);
  digitalWrite(MOTOR_RIGHT_B, LOW);

  // Setup analog pins for multiplexer as output
  pinMode(MUX_S0, OUTPUT);
  pinMode(MUX_S1, OUTPUT);
  pinMode(MUX_S2, OUTPUT);

  // IR LEDs transistor control
  pinMode(IR_EMIT_PIN, OUTPUT);

  pinMode(IR_REMREC_PIN, INPUT);

  // Set up I2C communication
  Wire.begin(SLAVE_ADDRESS);
  Wire.onReceive(receiveData);
  Wire.onRequest(sendData);
  Wire.setClock(1000000);


  //  //MPU6050 Test code
  //  Wire.beginTransmission(0x68); //0X68 is the MPU6050 ADDRESS
  //  Wire.write(0x6B);
  //  Wire.write(0);
  //  Wire.endTransmission(true);


  // LED setup
  pinMode(FRONT_RIGHT_LED, OUTPUT);
  pinMode(FRONT_LEFT_LED, OUTPUT);
  pinMode(BACK_RIGHT_LED, OUTPUT);
  pinMode(BACK_LEFT_LED, OUTPUT);
  pinMode(Z_LED, OUTPUT);

  // Buzzer Sound
  pinMode(BUZZER_PIN, OUTPUT);
  noTone(BUZZER_PIN); //make sure no sound comes out

  Serial.begin(115200);


  //  int16_t AccX,AccY,AccZ,Temp,GyroX,GyroY,GyroZ;
  //  double acc_z;
  //
  //  Wire.beginTransmission(MPU6050_addr);
  //  Wire.write(0x3B);
  //  Wire.endTransmission(false);
  //  Wire.requestFrom(MPU6050_addr,14,true);
  //
  //  AccX=Wire.read()<<8|Wire.read();
  //  AccY=Wire.read()<<8|Wire.read();
  //  AccZ=Wire.read()<<8|Wire.read();
  //  Temp=Wire.read()<<8|Wire.read();
  //  GyroX=Wire.read()<<8|Wire.read();
  //  GyroY=Wire.read()<<8|Wire.read();
  //  GyroZ=Wire.read()<<8|Wire.read();
  //  acc_z = AccZ/16384.0;
  //  Serial.println(acc_z);



  // OLED setup
  display.begin(SSD1306_SWITCHCAPVCC, 0x3C);
  display.clearDisplay(); //create empty display image
  display.display(); //display the cleared image
  display.setTextSize(1);
  display.setTextColor(WHITE);
  display.setCursor(0, 0);// Start at top-left corner

  Serial.print(F("Zumi version "));
  Serial.println(VERSION_NUMBER);
  Serial.println (F( __DATE__ " " __TIME__ " Ard ver." xstr(ARDUINO) "."));

  irTest();//checks the state of the IR sensors

  delay(50);

  pinMode(ARD_PI_PIN, OUTPUT); //setup this pin as an output
  digitalWrite(ARD_PI_PIN, HIGH);  // Prevents Pi from launching its boot script
  digitalWrite(Z_LED, LOW); // led will be off to indicate

  vccMilliVolts = readVccMilliVolts();
  // Get initial battery reading
  batteryVoltage = checkBattery();

  // Save battery voltage, prep for i2c
  outputArray[6] = (batteryVoltage - 1) * 58;
  outputArray[7] = (checkInputVCC() - 3) * 48;
  outputArray[8] = (VERSION_NUMBER - 1.1) * 10;

  byte chargingState = 0;


  //If the battery level is above MIN_BATTERY_VOLTAGE
  if (batteryVoltage > MIN_BATTERY_VOLTAGE)
  {
    chargeOnlyMode = false;
    chargingState = GOOD_BATTERY_DETECTED;
    zumi_LogoBlink();
    zumi_BatteryWindow();
    display.display();
    delay(3000);
  }
  else if (batteryVoltage > USB_VOLTAGE_DETECTED
           && batteryVoltage < MIN_BATTERY_VOLTAGE)
  {
    //battery is low
    chargeOnlyMode = false;
    chargingState = LOW_BATTERY_DETECTED;
    zumi_BatteryLowScreen();
  }
  else
  {
    chargingSound();
    //USB connected
    chargeOnlyMode = true;
    chargingState = USB_POWER_DETECTED;

    display.drawBitmap(0, 0, zumi_charging_fullsize, SCREEN_WIDTH, SCREEN_HEIGHT, 1);
    display.setTextSize(1);
    display.setCursor(38, 55);
    display.print(F("USB "));

    //display voltage of input USB
    display.print(checkInputVCC());
    display.print(F("V"));
    display.display();
    display.clearDisplay();
    delay(3000);
  }



  //---------------------------------------------------------------
  long loopTime = 0;
  long time_start = 0;

  unsigned int warningCounter = 0;
  unsigned int LEDcount = 0;    //to handle the timing for the LED's
  unsigned int lowBattCounter = 0; //counter for timing low battery levels
  byte IRcount = 0;     //timer for IR readings
  byte batteryCount = 0;//for battery timer

  byte battDetectedCount = 0;
  byte usbDetectedCount = 0;
  
  //Main program loop, continues forever
  while (1)
  {
    time_start = micros(); //keep track of time at start of loop
    
    receiveData();//check for I2C messages

    // Update LEDs
    if (LEDcount >= 500)
      //if more than 500ms have passed
    {
      updateLEDs();//update the blinking LEDS
      LEDcount = 0;//reset the blink timer counter
    }

    // Update battery level
    if (batteryCount >= 50)
      // if more than 50ms have passed
    {
      //update the vcc milli volts
      vccMilliVolts = readVccMilliVolts();
      //update battery level
      batteryVoltage = checkBattery();
      //scale up the values so they can be sent over as bytes
      outputArray[6] = (batteryVoltage - 1) * 58;
      outputArray[7] = (checkInputVCC() - 3) * 48;
      batteryCount = 0;
    }

    if (IRcount  >= 5)
      //if more than 5ms have passed
    {
      if (disable_IRreadings == false)
      {
        //Update IR data
        updateIRData();
      }
      else
      {
        delay(5);
        //set the ir array to 0
        for (byte i = 0; i < 6; i++) outputArray[i] = 0;
      }
      IRcount = 0;
    }

    // Increment counters
    LEDcount = loopTime / 1000 + LEDcount;
    batteryCount = loopTime / 1000 + batteryCount;
    IRcount = loopTime / 1000 + IRcount;
    //looptTimeis updated at the end of each loop

    // Code to be ran while the Pi is still booting up
    //and the arduino is still  the master I2C device
    // This will be false once the Pi sends an I2C message to disable pre-boot
    if ( arduinoI2CMaster == true )
    {
      //===================================================================
      //===================================================================
      switch (chargingState)
      {
        // if Zumi is Battery powered
        case GOOD_BATTERY_DETECTED://3
          //------------------------------------------------------
          {
            //if the Zumi booted into charge mode
            //and the battery is detected
            if (chargeOnlyMode == true
                && batteryVoltage > MIN_BATTERY_VOLTAGE)
            {
              zumi_bootCountdown();
            }
            if (chargeOnlyMode == false
                && batteryVoltage > MIN_BATTERY_VOLTAGE)
            {
              zumi_WakeUpAnimation();  // Display wake up animation
            }
            break;
          }
        //------------------------------------------------------
        // Battery is low -- notify user
        case LOW_BATTERY_DETECTED://2
          //------------------------------------------------------
          {
            batteryVoltage = checkBattery();//double check voltage sometimes fast switching is error prone
            if (batteryVoltage > USB_VOLTAGE_DETECTED)
              //check again if the not connected over USB
            {
              zumi_BatteryLowScreen();
            }
            break;
          }
        //------------------------------------------------------
        // This will display if the USB is connected
        case USB_POWER_DETECTED://1
          //------------------------------------------------------
          {
            if (chargeOnlyMode == true)
            {
              bootupCounter = 0; //reset boot up counter
              zumi_ChargingAnimation(); // Display charging animation on screen
            }
            else
            {
              zumi_WakeUpAnimation();  // Display wake up animation
            }
            break;
          }

      }//end of switch (chargingState)
      //===================================================================
      //===================================================================
    }//end of if (arduinoI2CMaster)

    //---------------------------------------------
    //once waking up animation is done begin warning countdown
    //the warning countdown will be prevented if the Pi send
    //over an I2C message indicating it has booted up
    if (arduinoI2CMaster == false)
    {
      if (warningCounter < 15000)//if after 15 seconds
      {
        warningCounter = warningCounter + loopTime / 1000;
      }
      else if (warningCounter >= 15000)
      { //after 20s have passed check if the pi has booted
        checkIfPiBooted();
      }
    }
    //---------------------------------------------
    //------------------------------------------------------
    // Code to be ran when running off of USB power only
    if (batteryVoltage <= USB_VOLTAGE_DETECTED)//if usb voltage detected
    {
      battDetectedCount = 0;
      usbDetectedCount =  usbDetectedCount + loopTime / 1000;
      if (chargingState != USB_POWER_DETECTED && usbDetectedCount > 200)
      { //if usb detected for more than 100ms toggle the charging state
        LEDbyte = 0b00000000;
        chargingSound();
        usbDetectedCount = 0;
        chargingState = USB_POWER_DETECTED;
      }
    }
    //------------------------------------------------------
    // Code to be ran when the battery is low between MIN volts and 1.79 volts
    else if (batteryVoltage > USB_VOLTAGE_DETECTED && batteryVoltage <= MIN_BATTERY_VOLTAGE)
    {
      if (DEBUG)Serial.println(lowBattCounter);
      if (lowBattCounter > 2000)
      {
        chargingState = LOW_BATTERY_DETECTED;
        Sound_Beep1();
        Sound_Beep1();
        lowBattCounter = 0;
        //Flash hazard lights
        LEDbyte = 0b11110000;
      }
      lowBattCounter = lowBattCounter + loopTime / 1000;
    }
    //------------------------------------------------------
    // Code to be ran when running off of battery power only
    else if ( batteryVoltage > MIN_BATTERY_VOLTAGE)
    {
      usbDetectedCount = 0; //toggle off the other counter
      battDetectedCount = battDetectedCount + loopTime / 1000;
      if (chargingState != GOOD_BATTERY_DETECTED && battDetectedCount > 200)
        //if batt detected for more than 100ms toggle the charging state
      {
        chargingState = GOOD_BATTERY_DETECTED;
        batteryPowerBeep();
        // Reset the LEDs
        LEDbyte = 0b00000000;
        battDetectedCount = 0;
      }
    }
    //------------------------------------------------------
    // Play a note
    if (noteType >= 0) playNote(noteType, noteDuration);
    //calculate the the time the loop takes and update it
    loopTime = micros() - time_start;
  }
}

void loop() {
  //no loop
}

void checkIfPiBooted()
{
  if ((millis() / 1000) > 50 //if after 50 seconds
      && displayWarning == false
      && PiBooted == false //Check if pi booted, this will be true when i2c Message is sent from pi
      && chargeOnlyMode == false)
  {
    digitalWrite(Z_LED, LOW); // Indicate to user that the Pi bootup enable has begun
    digitalWrite(ARD_PI_PIN, HIGH); //disable I2C in case if Pi happens to boot

    //draw an image of zumi failing to boot up, this is the warning
    display.drawBitmap(0, 0, cant_wake_up, SCREEN_WIDTH, SCREEN_HEIGHT, 1);
    displayWarning = true;
    //Pi never booted
    //Might be an SD card issue
    //or could be the pi is already booted
    display.display();

    digitalWrite(ARD_PI_PIN, LOW);  // Enable pi bootup
    digitalWrite(Z_LED, HIGH); // Indicate to user that the Pi bootup enable has begun
  }
}

void zumi_ChargingAnimation() {
  // Display charging animation on screen
  if (millis() / 1000 < 2 * 60 * 60)//if under 2 hours
  {
    display.clearDisplay();
    //---------------
    display.drawBitmap(0, 0, zumi_charging_fullsize, SCREEN_WIDTH, SCREEN_HEIGHT, 1);
    display.fillRect(43, 15, (millis() / 100) % 40, 15, WHITE);

    if ((millis() / 100) % 40 > 38)
    {
      //fill up the end of the battery image
      display.fillRect(81, 17, 4, 10, WHITE);
    }
    display.display();
  }
  else //otherwise remove the charging animation
  {
    display.clearDisplay();
    display.display();
  }
}

void zumi_BatteryLowScreen()
{
  /***************************************************

    You should only arrive here
    if during bootup Zumi detects a low battery
    this will display a low battery image

  ****************************************************/
  display.clearDisplay();
  //---------------
  zumi_BatteryWindow();
  display.setTextSize(2);
  display.setCursor(15, 45);
  display.print(F("LOW BATT"));
  //---------------
  display.display();
  display.clearDisplay();

}

void zumi_bootCountdown()
{
  /***************************************************

    You should only arrive here
    if Zumi was connected over USB while
    the switch was off
    and then the Zumi was switched to battery power

  ****************************************************/
  if (bootupCounter < 100) //initiate a bootup timer
  {
    bootupCounter++;
  }

  //---------------
  if (bootupCounter == 1)//bootupCounter < 40
  {
    display.clearDisplay();
    zumi_BatteryWindow();  // Display the battery level since in chargeOnlyMode
    display.setTextSize(1);
    display.setCursor(28, 40);
    display.print(F("Not Charging"));
    display.display();
    delay(1000);
  }

  if (bootupCounter > 1)
  {
    display.clearDisplay();
    display.setTextSize(1);
    display.setCursor(28, 44);
    display.print(F("Wait to Boot"));
    display.fillRect(43, 55, (bootupCounter / 100.0) * 38, 5, WHITE);
    display.drawRect(43, 55, 38, 5, WHITE);

    //---------------
    display.display();
  }

  if (bootupCounter == 100)
  {
    display.clearDisplay();
    chargeOnlyMode = false; //disable charge mode
  }
}

void zumi_WakeUpAnimation()
{

  if (wakingUpProgress <= 100)
  {
    if (millis() < 250 * 99) //check that 24.75 seconds havent passed
    {
      wakingUpProgress = millis() / 250 ;
    }
    else if (arduinoI2CMaster == true)
      //if 25 seconds have passed Pi
      //should have booted and the Python
      //script is waiting for the Pin to go Low
    {
      wakingUpProgress = wakingUpProgress + 11;
      //speed through waking up progress bar
    }
  }
  // Draw wakingUpProgress bar
  if (wakingUpProgress < 99 )
  {

    display.clearDisplay();
    //display the waking up icon
    display.drawBitmap(0, 0, zumi_woke_ing_up, SCREEN_WIDTH, SCREEN_HEIGHT, 1);
    display.fillRect(14, 30, wakingUpProgress, 3, WHITE);
    display.display();
  }
  else if (wakingUpProgress >= 100 && arduinoI2CMaster == true)
  {
    display.clearDisplay();
    display.display();
    arduinoI2CMaster = false;
    wakingUpProgress = 0;

    // Allow Pi to complete its boot up sequence
    digitalWrite(ARD_PI_PIN, LOW);  // Enable pi bootup
    digitalWrite(Z_LED, HIGH); // Indicate to user that the Pi bootup enable has begun
  }
}



void irTest() {
  /*
    Simple test that checks if any IR Sensors 
    are not working properly
    
    #define RIGHT_FRONT_IR  1
    #define LEFT_FRONT_IR   6

    #define RIGHT_BOTTOM_IR 2
    #define LEFT_BOTTOM_IR  4

    #define RIGHT_REAR_IR   3
    #define LEFT_REAR_IR    5

    if any of the IR sensors reaches around 255 in
    value it indicates that the infrared phototransitor
    is not allowing any current to pass through itself
    which may indicate that the phototransistor is damaged.
  */
  byte goodIRvalue = 250;
  //if one of the IR sensors fails
  //it fails at about a value of 250-255
  //and the value doesnt change.

  if (readIR(RIGHT_FRONT_IR, true) > goodIRvalue)
  {
    Serial.println(F("R_FRONT"));
    digitalWrite(FRONT_RIGHT_LED, HIGH);
    digitalWrite(FRONT_LEFT_LED, HIGH);
    delay(100);
    digitalWrite(FRONT_RIGHT_LED, LOW);
    digitalWrite(FRONT_LEFT_LED, LOW);
    delay(100);
  }
  if (readIR(LEFT_FRONT_IR, true) > goodIRvalue)
  {
    Serial.println(F("L_FRONT"));
    digitalWrite(FRONT_RIGHT_LED, HIGH);
    digitalWrite(FRONT_LEFT_LED, HIGH);
    delay(100);
    digitalWrite(FRONT_RIGHT_LED, LOW);
    digitalWrite(FRONT_LEFT_LED, LOW);
    delay(100);
  }
  if (readIR(RIGHT_BOTTOM_IR, true) > goodIRvalue)
  {
    Serial.println(F("R_BOTT"));
    digitalWrite(FRONT_RIGHT_LED, HIGH);
    digitalWrite(FRONT_LEFT_LED, HIGH);
    delay(100);
    digitalWrite(FRONT_RIGHT_LED, LOW);
    digitalWrite(FRONT_LEFT_LED, LOW);
    delay(100);
  }
  if (readIR(LEFT_BOTTOM_IR, true) > goodIRvalue)
  {
    Serial.println(F("L_BOTT"));
    digitalWrite(FRONT_RIGHT_LED, HIGH);
    digitalWrite(FRONT_LEFT_LED, HIGH);
    delay(100);
    digitalWrite(FRONT_RIGHT_LED, LOW);
    digitalWrite(FRONT_LEFT_LED, LOW);
    delay(100);
  }
  if (readIR(RIGHT_REAR_IR, true) > goodIRvalue)
  {
    Serial.println(F("R_REAR"));
    digitalWrite(FRONT_RIGHT_LED, HIGH);
    digitalWrite(FRONT_LEFT_LED, HIGH);
    delay(100);
    digitalWrite(FRONT_RIGHT_LED, LOW);
    digitalWrite(FRONT_LEFT_LED, LOW);
    delay(100);
  }
  if (readIR(LEFT_REAR_IR, true) > goodIRvalue)
  {
    Serial.println(F("L_REAR"));
    digitalWrite(FRONT_RIGHT_LED, HIGH);
    digitalWrite(FRONT_LEFT_LED, HIGH);
    delay(100);
    digitalWrite(FRONT_RIGHT_LED, LOW);
    digitalWrite(FRONT_LEFT_LED, LOW);
    delay(100);
  }
}

void zumi_BatteryWindow() {

  byte battper = batteryPercentage(batteryVoltage);
  display.drawBitmap(0, 0, emptyBattery, SCREEN_WIDTH, SCREEN_HEIGHT, 1);
  display.setTextSize(1);
  display.setCursor(55, 0);
  display.print(battper);
  display.print(F("%"));

  // fill the battery percent to the battery block
  // Battery block is 39 pixels in width
  display.fillRect(43, 15,  (battper * 39) / 100.0, 15, WHITE);
  if (battper == 100)
  {
    //this for the end of the battery a small little rectangle
    display.fillRect(81, 17, 4, 10, WHITE);
  }
}


void zumi_LogoBlink() {

  //display the logo animation
  display.clearDisplay();

  display.setTextSize(1);
  // Will produce the Zumi logo with blinking eyes
  display.drawBitmap(0, 0, zumi_logo_fullsize, SCREEN_WIDTH, SCREEN_HEIGHT, 1);
  display.setCursor(50, 55);
  display.print(F("v"));
  display.print(VERSION_NUMBER);
  display.display();
  delay(500);
  wakeUpSound();
  display.clearDisplay();

  display.drawBitmap(0, 0, zumi_logo_fullsize, SCREEN_WIDTH, SCREEN_HEIGHT, 1);
  display.fillCircle(42, 23, 4, BLACK);
  display.fillCircle(56, 25, 4, BLACK);
  display.setCursor(50, 55);
  display.print(F("v"));
  display.print(VERSION_NUMBER);
  display.display();
  delay(300);
  display.clearDisplay();

  display.drawBitmap(0, 0, zumi_logo_fullsize, SCREEN_WIDTH, SCREEN_HEIGHT, 1);
  display.setCursor(50, 55);
  display.print(F("v"));
  display.print(VERSION_NUMBER);
  display.display();
  delay(250);
  display.clearDisplay();

  display.drawBitmap(0, 0, zumi_logo_fullsize, SCREEN_WIDTH, SCREEN_HEIGHT, 1);
  display.fillCircle(42, 23, 4, BLACK);
  display.fillCircle(56, 25, 4, BLACK);
  display.setCursor(50, 55);
  display.print(F("v"));
  display.print(VERSION_NUMBER);
  display.display();
  delay(250);
  display.clearDisplay();

  display.drawBitmap(0, 0, zumi_logo_fullsize, SCREEN_WIDTH, SCREEN_HEIGHT, 1);
  display.setCursor(50, 55);
  display.print(F("v"));
  display.print(VERSION_NUMBER);
  display.display();
  delay(300);

  // Once done, clear the screen
  display.clearDisplay();
}

void updateIRData() {
  /*
   * Reads and stores the IR sensor readings into 
   * the output array that is sent to the Pi over I2C
   */
  for (byte i = 0; i < 6; i++) 
  {
    // Fill elements 0 - 5 in output array with IR data
    outputArray[i] = readIR(i + 1, IREmitOn);  
  }
  
}

void updateLEDs() {
 // Alternate between reading from left 4 bits and right 4 bits every 500 milliseconds
  LEDtoggle = 1 - LEDtoggle;  
 
  if (disable_led_byte == false)
  {
    digitalWrite(FRONT_LEFT_LED, bitRead(LEDbyte, 7 - ( 4 * LEDtoggle)));
    digitalWrite(FRONT_RIGHT_LED, bitRead(LEDbyte, 6 - ( 4 * LEDtoggle)));
    digitalWrite(BACK_LEFT_LED, bitRead(LEDbyte, 5 - ( 4 * LEDtoggle)));
    digitalWrite(BACK_RIGHT_LED, bitRead(LEDbyte, 4 - ( 4 * LEDtoggle)));
  }
}


long readVccMilliVolts()
{
  long result;
  // Read 1.1V reference against AVcc
  ADMUX = _BV(REFS0) | _BV(MUX3) | _BV(MUX2) | _BV(MUX1);
  delay(2);             // Wait for Vref to settle
  ADCSRA |= _BV(ADSC);  // Convert
  while (bit_is_set(ADCSRA, ADSC));
  result = ADCL;
  result |= ADCH << 8;
  result = 1126400L / result; // Back-calculate AVcc in mV
  return result;
}


byte batteryPercentage(double batteryVoltage) {
  byte battPercent = 0;
  //Each battery will reach different max voltages.
  //For example: 4.14, 4.19.
  if (batteryVoltage > MIN_BATTERY_VOLTAGE)
  {
    battPercent = (batteryVoltage - MIN_BATTERY_VOLTAGE) / (MAX_BATTERY_VOLTAGE - MIN_BATTERY_VOLTAGE) * 100;
  }

  if (battPercent > 100)
  {
    battPercent = 100;
  }
  else if (battPercent < 0)
  {
    battPercent = 0;
  }
  return battPercent;
}


double checkBattery()
{
  //double bitsPerVolts = 1023.0 / (vccMilliVolts * 0.001);
  //double battLevel = analogRead(BATT_LVL_PIN) /  ( 1023.0 / (vccMilliVolts * 0.001));
  return analogRead(BATT_LVL_PIN) /  ( 1023.0 / (vccMilliVolts * 0.001));
}

double checkInputVCC()
{
  //If the Vcc rail = 5v then this value should equal 5 volts
  //double vcc =  (vccMilliVolts * 0.001) ;
  return (vccMilliVolts * 0.001);
}

byte readIR(byte indexOfIRSensor, bool emitterOn)
{
  //front IR sensors
  //  rightFrontIR  = 1
  //  leftFrontIR   = 6
  //  rightFrontIRw = 0
  //  leftFrontIRw  = 7
  //bottom IR sensors
  //  rightBottomIR = 2
  //  leftBottomIR  = 4
  //Rear IR sensors
  // rightRearIR    = 3
  //  leftRearIR    = 5

  // Select different channels on the Multiplexer
  switch (indexOfIRSensor) {
    //--------------------------------------
    case 0:
      //000 = 0
      digitalWrite(15, LOW);
      digitalWrite(16, LOW);
      digitalWrite(17, LOW);
      break;
    //--------------------------------------
    case 1://Y1 rightFrontIR
      //001 = 1
      digitalWrite(15, HIGH);
      digitalWrite(16, LOW);
      digitalWrite(17, LOW);
      break;
    //--------------------------------------
    case 2://Y2 rightBottomIR
      //010 = 2
      digitalWrite(15, LOW);
      digitalWrite(16, HIGH);
      digitalWrite(17, LOW);
      break;
    //--------------------------------------
    case 3://Y3 rightRearIR
      //011 = 3
      digitalWrite(15, HIGH);
      digitalWrite(16, HIGH);
      digitalWrite(17, LOW);
      break;
    //--------------------------------------
    case 4://Y4 leftBottomIR
      //100 = 4
      digitalWrite(15, LOW);
      digitalWrite(16, LOW);
      digitalWrite(17, HIGH);
      break;
    //--------------------------------------
    case 5://Y5 leftRearIR
      //101 = 5
      digitalWrite(15, HIGH);
      digitalWrite(16, LOW);
      digitalWrite(17, HIGH);
      break;
    //--------------------------------------
    case 6://Y6 leftFrontIR
      //110 = 6
      digitalWrite(15, LOW);
      digitalWrite(16, HIGH);
      digitalWrite(17, HIGH);
      break;
    //--------------------------------------
    case 7://Y7
      //111 = 7
      digitalWrite(15, HIGH);
      digitalWrite(16, HIGH);
      digitalWrite(17, HIGH);
      break;
    //--------------------------------------
    default:
      break;
  }

  if (emitterOn) digitalWrite(IR_EMIT_PIN, HIGH);
  else digitalWrite(IR_EMIT_PIN, LOW);

  // Allow the voltage to rise a bit after switching on the multiplexer
  delayMicroseconds(1000);

  // Reduce voltage to a value between 0-255 for sending over I2C as a byte
  byte value = analogRead(MUX_OUTPUT) / 4;

  digitalWrite(IR_EMIT_PIN, LOW);
  return value;
}

void setMotorsToSpeed(int speedM1, int speedM2)
{
  byte motorState = 0;
  if (speedM1 < 0) {
    bitSet(motorState, 1);
    speedM1 = abs(speedM1);
  }
  if (speedM2 < 0) {
    bitSet(motorState, 0);
    speedM2 = abs(speedM2);
  }

  switch (motorState) {
    //--------------------------------------
    case 0://forward
      //00
      analogWrite(MOTOR_LEFT_A, speedM1);
      analogWrite(MOTOR_LEFT_B, 0);
      analogWrite(MOTOR_RIGHT_A, speedM2);
      analogWrite(MOTOR_RIGHT_B, 0);
      break;
    //--------------------------------------
    case 1://right with both motors
      //01
      analogWrite(MOTOR_LEFT_A, speedM1);
      analogWrite(MOTOR_LEFT_B, 0);
      analogWrite(MOTOR_RIGHT_A, 0);
      analogWrite(MOTOR_RIGHT_B, speedM2);
      break;
    //--------------------------------------
    case 2://left with both motors
      //10
      analogWrite(MOTOR_LEFT_A, 0);
      analogWrite(MOTOR_LEFT_B, speedM1);
      analogWrite(MOTOR_RIGHT_A, speedM2);
      analogWrite(MOTOR_RIGHT_B, 0);
      break;
    //--------------------------------------
    case 3://backward
      //11
      analogWrite(MOTOR_LEFT_A, 0);
      analogWrite(MOTOR_LEFT_B, speedM1);
      analogWrite(MOTOR_RIGHT_A, 0);
      analogWrite(MOTOR_RIGHT_B, speedM2);
      break;
    //--------------------------------------
    default:
      break;
  }

}

int convertFromPiSpeed(int piSpeed) {
  // The speed sent by the Pi needs to be raised a bit to prevent the motors from stalling
  if ( piSpeed > 127 ) {
    piSpeed %= 127;
    piSpeed *= -1;
  }
  piSpeed += piSpeed * 50 / abs(piSpeed);
  return piSpeed;
}

void playNote(int note, int duration) {
  if ( note > 0 && !disable_sound)
  {
    tone(BUZZER_PIN, 65.1772 * exp(0.057822 * (note - 1)), duration);  // Calculate frequency
  }
  else noTone(BUZZER_PIN);
  noteType = -1;
}


//-------------------------------- Buzzer ------------------------------------------//
//----------------------------------------------------------------------------------//

void chargingSound()
{
  int melody[] = {1500, 1500, 1500, 3000, 2000, 2500, 2500};
  byte tempo[] = {25, 25, 25, 25, 25, 25, 25};
  SoundProcess(melody, tempo, 7);
}

void Sound_Beep1()
{
  int melody[] = {2637, 1568, 1216};
  byte tempo[] = {16, 16, 12};
  SoundProcess(melody, tempo, 3);
}
//----------------------------------------------------------------------------------//
void Sound_Beep2()
{
  int melody[] = {167, 593};
  byte tempo[] = {64, 8};

  SoundProcess(melody, tempo, 2);
}

void batteryPowerBeep()
{
  int melody[] = {2437, 1968, 1216, 900};
  byte tempo[] = {25, 25, 25, 25};
  SoundProcess(melody, tempo, 3);
}

//----------------------------------------------------------------------------------//
void wakeUpSound()
{
  int melody[] = {1319, 1568, 2637, 2093, 2349, 3136};
  byte tempo[] = {25, 25, 25, 25, 25, 25};
  SoundProcess(melody, tempo, 6);
}

//----------------------------------------------------------------------------------//
void SoundProcess(int _melody[], byte _tempo[], byte _size)
{
  if (!disable_sound)
  {
    for (byte thisNote = 0; thisNote < _size; thisNote++)
    {
      int noteDuration = 1000 / _tempo[thisNote];
      tone(BUZZER_PIN, _melody[thisNote], noteDuration);
      int pauseBetweenNotes = noteDuration * 1.30;
      delay(pauseBetweenNotes);
    }
  }
}


void receiveData() {
  //Commands are given as a single byte, where the bits are parsed as shown:
  // XXYYYZZZ 1 BYTE

  if (Wire.available())
  {
    byte receivedByte = Wire.read();
    byte commandType = receivedByte >> 6;  // Get 2 most significant bits 00 --- ---
    byte command = receivedByte & 0x38;  // Get 3rd-5th most significant bits -- 000 ---
    command = command >> 3;
    byte extraBits = receivedByte & 0x07;  // Get 3 least significant bits -- --- 000

    if (DEBUG == 1)
    {
      Serial.print(receivedByte);
      Serial.print(F(","));
    }

    switch (commandType) //(XX)YYYZZZ
    {
      //-------------------------------------------------------------------------------
      case 0:  // motor commands XX = 00
        //~~~~~~~~~~~~~~~~~~~~~~~~~~~~~~~~~~~~~~~~~~~~~~~~~~~~~~~~~~~~~~~~~~~~~~~~~~~~
        //~~~~~~~~~~~~~~~~~~~~~~~~~~~~~~~~~~~~~~~~~~~~~~~~~~~~~~~~~~~~~~~~~~~~~~~~~~~~
        switch (command)//00(YYY)ZZZ
        {
          case 0: //YYY = 000
            // stop Zumi
            setMotorsToSpeed(0, 0);
            if (DEBUG == 1) Serial.print(F(" STOP "));
            break;

          case 1: //YYY = 001
            // stop Zumi
            setMotorsToSpeed(0, 0);
            break;

          case 2: //YYY = 010
            // Zumi's speed will instantly become target speed
            if (bitRead(extraBits, 0) == 0)//00(YYY)ZZZ
            {
              int speed2 = convertFromPiSpeed(Wire.read());
              int speed1 = convertFromPiSpeed(Wire.read());

              setMotorsToSpeed(speed1, speed2);

              if (DEBUG == 1)
              {
                Serial.print(F(" M1 "));
                Serial.print(speed1);
                Serial.print(F(" M2 "));
                Serial.print(speed2);
              }
            }
            break;

          case 3: //YYY = 011
            // Zumi will instantly stop

            setMotorsToSpeed(0, 0);
            break;

          default:
            break;
        }
        //~~~~~~~~~~~~~~~~~~~~~~~~~~~~~~~~~~~~~~~~~~~~~~~~~~~~~~~~~~~~~~~~~~~~~~~~~~~~
        //~~~~~~~~~~~~~~~~~~~~~~~~~~~~~~~~~~~~~~~~~~~~~~~~~~~~~~~~~~~~~~~~~~~~~~~~~~~~
        break;
      //-------------------------------------------------------------------------------
      case 1:  // Audio commands XX = 01
        ////XX(YYYZZZ)
        noteType = receivedByte & 0x3F;  // The rightmost 6 bits of the byte sent over I2C contain the number of the note
        noteDuration = Wire.read() * 10; // receive a number from the Pi, 0-250 and then scale it up to map from 0 - 2500
        if (DEBUG)
        {
          Serial.print(noteType);
          Serial.print(F(",|Note D."));
          Serial.print(noteDuration);
        }
        break;
      //-------------------------------------------------------------------------------
      case 2:  // LED commands XX = 10
        if (receivedByte == 128) //1000 0000
        {
          disable_led_byte = false;
          LEDbyte = Wire.read();
          if (DEBUG)
          {
            Serial.print(F(",|Led "));
            Serial.print(LEDbyte);
          }
        }

        break;
      //-------------------------------------------------------------------------------
      case 3: // Pre-boot off XX = 11
        if (receivedByte == 192) //1100 0000
        {
          //this will be called
          //whenever the pi wants to request
          //data from the Zumi
          arduinoI2CMaster = false;
          PiBooted = true;
          if (DEBUG == 1)Serial.print(F(",|PiBoot "));
        }

        else if (receivedByte == 193)
        {
          digitalWrite(Z_LED, HIGH);
        }
        else if (receivedByte == 194)
        {
          digitalWrite(Z_LED, LOW);
        }


        else if (receivedByte == 195)
        {
          disable_sound = false;
        }
        else if (receivedByte == 196)
        {
          disable_sound = true;
        }


        else if (receivedByte == 197)
        {
          disable_led_byte = true;
        }
        else if (receivedByte == 198)
        {
          disable_led_byte = false;
        }

        else if (receivedByte == 199)
        {
          disable_led_byte = true;
          digitalWrite(FRONT_LEFT_LED, HIGH);
        }
        else if (receivedByte == 200)
        {
          disable_led_byte = true;
          digitalWrite(FRONT_LEFT_LED, LOW);
        }


        else if (receivedByte == 201)
        {
          disable_led_byte = true;
          digitalWrite(FRONT_RIGHT_LED, HIGH);
        }
        else if (receivedByte == 202)
        {
          disable_led_byte = true;
          digitalWrite(FRONT_RIGHT_LED, LOW);
        }


        else if (receivedByte == 203)
        {
          disable_led_byte = true;
          digitalWrite(BACK_LEFT_LED, HIGH);
        }
        else if (receivedByte == 204)
        {
          disable_led_byte = true;
          digitalWrite(BACK_LEFT_LED, LOW);
        }


        else if (receivedByte == 205)
        {
          disable_led_byte = true;
          digitalWrite(BACK_RIGHT_LED, HIGH);
        }
        else if (receivedByte == 206)
        {
          disable_led_byte = true;
          digitalWrite(BACK_RIGHT_LED, LOW);
        }



        else if (receivedByte == 207)
        {
          IREmitOn = true;
        }
        else if (receivedByte == 208)
        {
          IREmitOn = false;
        }


        else if (receivedByte == 209)
        {
          disable_IRreadings = true;
        }
        else if (receivedByte == 210)
        {
          disable_IRreadings = false;
        }
        
        //Open for user defined methods
        else if (receivedByte == 211)
        {
         //some fast code
        }

        else if (receivedByte == 212)
        {
         //some fast code
        }

        break;
      //-------------------------------------------------------------------------------
      default:
        break;
        //-------------------------------------------------------------------------------

    }
    if (DEBUG == 1 )Serial.println(F(""));
  }
}

void sendData() {
  Wire.write(outputArray, 10);  // Send IR sensor data and current batt voltage in one block
}
